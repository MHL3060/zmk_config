## config/Kconfig.defconfig
```kconfig
# Copyright (c) 2020 The ZMK Contributors
# SPDX-License-Identifier: MIT

if SHIELD_RK87

config ZMK_KEYBOARD_NAME
    default "Rk87BMP"

endif
```

## rk87/Kconfig.shield
```kconfig
# Copyright (c) 2020 The ZMK Contributors
# SPDX-License-Identifier: MIT

config SHIELD_RK87
    def_bool $(shields_list_contains,rk87)
```
